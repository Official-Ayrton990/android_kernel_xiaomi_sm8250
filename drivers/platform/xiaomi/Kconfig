## drivers/platform/xiaomi/Kconfig
```kconfig
# Xiaomi configuration options

config MACH_XIAOMI
	bool "Xiaomi device"
	depends on ARCH_QCOM
	help
	  Support for Xiaomi products

config MACH_XIAOMI_SM7250
	bool "Xiaomi SM7250"
	depends on ARCH_QCOM
	select MACH_XIAOMI
	help
	  Support for Xiaomi SM7250 devices

config MACH_XIAOMI_SM8250
	bool "Xiaomi SM8250"
	depends on ARCH_QCOM
	select MACH_XIAOMI
	help
	  Support for Xiaomi SM8250 devices

menu "Xiaomi board selection"

	config MACH_XIAOMI_ALIOTH
		bool "Xiaomi alioth board"
		select MACH_XIAOMI_SM8250
		help
		  Support for Redmi K40/POCO F3/Mi 11X

	config MACH_XIAOMI_APOLLO
		bool "Xiaomi apollo board"
		select MACH_XIAOMI_SM8250
		help
		  Support for Mi 10T/Mi 10T Pro/Redmi K30S Ultra

	config MACH_XIAOMI_CAS
		bool "Xiaomi cas board"
		select MACH_XIAOMI_SM8250
		help
		  Support for Mi 10 Ultra

	config MACH_XIAOMI_CMI
		bool "Xiaomi cmi board"
		select MACH_XIAOMI_SM8250
		help
		  Support for Mi 10 Pro

	config MACH_XIAOMI_LMI
		bool "Xiaomi lmi board"
		select MACH_XIAOMI_SM8250
		help
		  Support for Redmi K30 Pro/POCO F2 Pro

	config MACH_XIAOMI_MONET
		bool "Xiaomi monet board"
		select MACH_XIAOMI_SM7250
		help
		  Support for Mi 10 Lite

	config MACH_XIAOMI_PICASSO
		bool "Xiaomi picasso board"
		select MACH_XIAOMI_SM7250
		help
		  Support for Redmi K30 5G/Redmi K30i 5G

	config MACH_XIAOMI_THYME
		bool "Xiaomi thyme board"
		select MACH_XIAOMI_SM8250
		help
		  Support for Mi 10S

	config MACH_XIAOMI_UMI
		bool "Xiaomi umi board"
		select MACH_XIAOMI_SM8250
		help
		  Support for Mi 10

	config MACH_XIAOMI_VANGOGH
		bool "Xiaomi vangogh board"
		select MACH_XIAOMI_SM7250
		help
		  Support for Mi 10 Lite Zoom

endmenu
```

## techpack/data/Kconfig
```kconfig
menu "Qualcomm RmNet extensions"

#source "techpack/data/emac-dwc-eqos/Kconfig_app"

#source "techpack/data/generic-sw-bridge/Kconfig"

source "techpack/data/rmnet/Kconfig"

endmenu
```
